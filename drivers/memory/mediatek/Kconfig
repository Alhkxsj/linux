## drivers/memory/mediatek/Kconfig
```kconfig
# SPDX-License-Identifier: GPL-2.0

config MTK_DRAMC
	bool "MediaTek DRAMC driver"
	depends on ARCH_MEDIATEK
	help
	  Read-only visibility into the MediaTek DRAM controller:
	  fmeter-based data-rate reporting and DDR type / mode-register
	  information.

config MTK6895_DVFSRC_PIN
	bool "MT6895 DVFSRC manual DDR-OPP pinning"
	depends on ARCH_MEDIATEK && MTK_DRAMC
	help
	  Expose the raw DVFSRC SW_REQ dram-level nibble so the DRAM
	  operating point can be pinned by hand while the full
	  bandwidth-vote stack is not ported yet.
```

## drivers/misc/mediatek/flashlight/Kconfig
```kconfig
menuconfig MTK_FLASHLIGHT
	tristate "MTK flashlight support"
	depends on LEDS_CLASS_FLASH || !LEDS_CLASS_FLASH
	default n

if MTK_FLASHLIGHT

config MTK_FLASHLIGHT_CORE
	tristate "MTK flashlight core"
	depends on MTK_FLASHLIGHT

source "drivers/misc/mediatek/flashlight/v4l2/Kconfig"

endif
```
